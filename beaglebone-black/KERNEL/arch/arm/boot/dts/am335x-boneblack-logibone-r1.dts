/dts-v1/;

#include "am33xx.dtsi"
#include "am335x-bone-common.dtsi"
#include "am335x-bone-common-pinmux.dtsi"

/ {
	model = "TI AM335x BeagleBone";
	compatible = "ti,am335x-bone-black", "ti,am335x-bone", "ti,am33xx";
};

&ldo3_reg {
        regulator-min-microvolt = <1800000>;
        regulator-max-microvolt = <1800000>;
        regulator-always-on;
};

&mmc1 {
        vmmc-supply = <&vmmcsd_fixed>;
};

&am33xx_pinmux {
        pinctrl-names = "default";
        pinctrl-0 = <&clkout2_pin>;
};

#include "am335x-boneblack-nxp-hdmi-no-audio.dtsi"
#include "am335x-bone-logibone-r1.dtsi"
#include "am335x-bone-spi1-spidev.dtsi"
#include "am335x-bone-emmc-in-reset.dtsi"
